// File generated 27/02/2014 20:20:00
// Warning! This is a generated file, any manual changes will be
// lost during the next generation.

#DATA
    byte ikeyboard1keystrokes 0x07, 0x08, 0x09, 0x04, 0x05, 0x06, 0x01, 0x02, 0x03, 0x6E, 0x00, 0x64
#END


// object indexes into ImageControl
#CONST
    ikeyboard1      // offset 0x0
    ikeyboard1_0    // offset 0x25000
    ikeyboard1_1    // offset 0x29800
    ikeyboard1_2    // offset 0x2E000
    ikeyboard1_3    // offset 0x32800
    ikeyboard1_4    // offset 0x37000
    ikeyboard1_5    // offset 0x3B800
    ikeyboard1_6    // offset 0x40000
    ikeyboard1_7    // offset 0x44800
    ikeyboard1_8    // offset 0x49000
    ikeyboard1_9    // offset 0x4D800
    ikeyboard1_10   // offset 0x52000
    ikeyboard1_11   // offset 0x56800
    iledCode        // offset 0x5B000
    iiledCode       // offset 0x5F600
#END

var disk, hndl ;
var okeyboard1[12] := [-1, 0, 0, 0, 0, 255, 255, 255, 255, 255, 12, 0] ;
