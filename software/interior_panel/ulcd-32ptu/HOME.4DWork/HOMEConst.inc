// File generated 15/03/2014 23:33:20
// Warning! This is a generated file, any manual changes will be
// lost during the next generation.

#constant  strDayCount    7
#constant  strDaySize     9
#constant  strAlarmCount    2
#constant  strAlarmSize     22
// object indexes into ImageControl
#CONST
    idigitsTemp     // offset 0x0
    iidigitsTemp    // offset 0xE00
    idigitsHour     // offset 0x5000
    iidigitsHour    // offset 0x7800
    idigitsMinute   // offset 0x12C00
    iidigitsMinute  // offset 0x15400
    ilblTimeSeparator // offset 0x20800
    ilblTemp        // offset 0x20E00
#END

#constant  strDayStartH   0x0
#constant  strDayStartL   0x0
#constant  strAlarmStartH   0x0
#constant  strAlarmStartL   0x200
var disk, hndl ;
